#include "runtype58.dtsi" 

&kscan0 {
    col-gpios
        = <&gpio0 29 GPIO_ACTIVE_HIGH> // col1 in the schematic
        , <&gpio0 2 GPIO_ACTIVE_HIGH> // col2 in the schematic
        , <&gpio1 15 GPIO_ACTIVE_HIGH> // col3 in the schematic
        , <&gpio1 13 GPIO_ACTIVE_HIGH> // col4 in the schematic
        , <&gpio1 11 GPIO_ACTIVE_HIGH> // col5 in the schematic
        , <&gpio0 10 GPIO_ACTIVE_HIGH> // col6 in the schematic
        , <&gpio0 9 GPIO_ACTIVE_HIGH> // col7 in the schematic
        ;
};