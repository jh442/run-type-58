## config/boards/shields/runtype58/Kconfig.defconfig
```kconfig
# Copyright (c) 2022 The ZMK Contributors
# SPDX-License-Identifier: MIT

if SHIELD_RUNTYPE58_LEFT

config ZMK_KEYBOARD_NAME
    default "RunType58"

config ZMK_SPLIT_ROLE_CENTRAL
    default y

endif

if SHIELD_RUNTYPE58_LEFT || SHIELD_RUNTYPE58_RIGHT
config ZMK_SPLIT
    default y
endif
```

## config/boards/shields/runtype58/Kconfig.shield
```kconfig
# Copyright (c) 2022 The ZMK Contributors
# SPDX-License-Identifier: MIT

config SHIELD_RUNTYPE58_LEFT
    def_bool $(shields_list_contains,runtype58_left)

config SHIELD_RUNTYPE58_RIGHT
    def_bool $(shields_list_contains,runtype58_right)
```
